/* SPDX-License-Identifier: Apache-2.0 OR MIT */
/*
 * A VL53L0X at 0x29, its default address, on I2C0 (i2c0.overlay), with no
 * XSHUT line.
 */

&i2c0 {
	vl53l0x@29 {
		compatible = "st,vl53l0x";
		reg = <0x29>;
	};
};

/* SPDX-License-Identifier: Apache-2.0 OR MIT */
/*
 * The sample's app.overlay puts its zfm-x0 on uart1 at 57600 baud, the
 * ZFM-20's factory rate (user manual V1.5, 4.4.1: N = 6); uart1_gp8_gp9
 * sets 115200 after it, so this restores the part's rate.
 */

&uart1 {
	current-speed = <57600>;
};

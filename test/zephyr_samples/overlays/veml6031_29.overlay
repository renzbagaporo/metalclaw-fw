/* SPDX-License-Identifier: Apache-2.0 OR MIT */
/* A VEML6031X00 at 0x29 on I2C0 (i2c0.overlay), the node the sample names light. */

&i2c0 {
	light: veml6031@29 {
		compatible = "vishay,veml6031";
		reg = <0x29>;
		status = "okay";
	};
};

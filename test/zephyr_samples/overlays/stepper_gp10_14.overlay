/* SPDX-License-Identifier: Apache-2.0 OR MIT */
/*
 * samples/drivers/stepper/generic's TMC2209 and step/dir controller, as its
 * nucleo_g071rb overlay wires them, on GP10 (EN), GP11 (M0), GP12 (M1),
 * GP13 (STEP) and GP14 (DIR). Its mode button is any input device: sw0 on
 * GP15 (sw0_gp15.overlay).
 */
#include <zephyr/dt-bindings/gpio/gpio.h>

/ {
	aliases {
		stepper-driver = &tmc2209;
		stepper-ctrl = &step_dir_motion_control;
	};

	tmc2209: stepper-driver {
		compatible = "adi,tmc2209";
		en-gpios = <&gpio0 10 GPIO_ACTIVE_HIGH>;
		m0-gpios = <&gpio0 11 GPIO_ACTIVE_HIGH>;
		m1-gpios = <&gpio0 12 GPIO_ACTIVE_HIGH>;
		micro-step-res = <32>;
	};

	step_dir_motion_control: motion-controller {
		compatible = "zephyr,gpio-step-dir-stepper-ctrl";
		step-gpios = <&gpio0 13 GPIO_ACTIVE_HIGH>;
		dir-gpios = <&gpio0 14 GPIO_ACTIVE_HIGH>;
		invert-direction;
		stepper-driver = <&tmc2209>;
	};
};

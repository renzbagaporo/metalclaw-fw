## CMakeLists.txt
```
# SPDX-License-Identifier: Apache-2.0 OR MIT

cmake_minimum_required(VERSION 3.20.0)

find_package(Zephyr REQUIRED HINTS $ENV{ZEPHYR_BASE})
project(metalclaw_dut)

target_sources(app PRIVATE src/main.c src/mailbox.c src/uart_echo.c)

# The device whose overlay this image carries; "smoke" for none. The ID
# command reports it so the rig can skip cases the image cannot serve.
set(METALCLAW_DUT_IMAGE_NAME "smoke" CACHE STRING "device this image is built for")
target_compile_definitions(app PRIVATE IMAGE_NAME="${METALCLAW_DUT_IMAGE_NAME}")
```

## west.yml
```
# SPDX-License-Identifier: Apache-2.0 OR MIT
# The DUT fixture's Zephyr workspace. `just setup-dut` initialises it outside
# the repository at METALCLAW_ZEPHYR_WORKSPACE (default ../.zephyr-workspace).
manifest:
  remotes:
    - name: zephyrproject
      url-base: https://github.com/zephyrproject-rtos
  projects:
    - name: zephyr
      remote: zephyrproject
      revision: v4.4.0
      import:
        name-allowlist:
          - cmsis
          - cmsis_6
          - hal_rpi_pico
          - picolibc
          - littlefs
          - loramac-node
```

## prj.conf
```kconfig
# SPDX-License-Identifier: Apache-2.0 OR MIT

CONFIG_GPIO=y

CONFIG_SERIAL=n
CONFIG_UART_CONSOLE=n
CONFIG_UART_INTERRUPT_DRIVEN=n
CONFIG_CONSOLE=n
CONFIG_BOOT_BANNER=n
CONFIG_SHELL=n
CONFIG_LOG=n
CONFIG_USB_DEVICE_STACK=n
CONFIG_USB_DEVICE_STACK_NEXT=n

CONFIG_MAIN_STACK_SIZE=1024
```

## boards/rpi_pico.conf
```kconfig
# SPDX-License-Identifier: Apache-2.0 OR MIT

# The RP2040 has no entropy source Zephyr drives, and networking needs
# sys_rand_get(); the Pico 2's TRNG covers it there. Test-quality numbers
# are all a DUT fixture needs.
CONFIG_TEST_RANDOM_GENERATOR=y

# The Pico 2 board adds a 16 KiB system heap (getaddrinfo allocates from
# it); match it.
CONFIG_HEAP_MEM_POOL_SIZE=16384
```

## src/mailbox.c
```c
// SPDX-License-Identifier: Apache-2.0 OR MIT

#include "mailbox.h"

#include <zephyr/sys/barrier.h>
#include <zephyr/toolchain.h>

#include <string.h>

struct mclw_dut_mailbox_command mclw_dut_mailbox_command __aligned(4);
struct mclw_dut_mailbox_result mclw_dut_mailbox_result __aligned(4);

static char result_line[MCLW_DUT_MAILBOX_RESULT_CAPACITY];
static size_t result_used;
static uint32_t command_seen;

static void initialise_header(uint32_t *magic0, uint32_t *magic1, uint32_t *version,
	uint32_t *capacity, uint32_t magic1_value, uint32_t capacity_value)
{
	*capacity = capacity_value;
	*version = MCLW_DUT_MAILBOX_VERSION;
	barrier_dmem_fence_full();
	*magic1 = magic1_value;
	barrier_dmem_fence_full();
	*magic0 = MCLW_DUT_MAILBOX_MAGIC0;
}

void mclw_dut_mailbox_init(void)
{
	memset(&mclw_dut_mailbox_command, 0, sizeof(mclw_dut_mailbox_command));
	memset(&mclw_dut_mailbox_result, 0, sizeof(mclw_dut_mailbox_result));
	result_used = 0U;
	command_seen = 0U;
	barrier_dmem_fence_full();
	initialise_header(&mclw_dut_mailbox_command.magic0, &mclw_dut_mailbox_command.magic1,
		&mclw_dut_mailbox_command.version, &mclw_dut_mailbox_command.capacity,
		MCLW_DUT_MAILBOX_COMMAND_MAGIC1, MCLW_DUT_MAILBOX_COMMAND_CAPACITY);
	initialise_header(&mclw_dut_mailbox_result.magic0, &mclw_dut_mailbox_result.magic1,
		&mclw_dut_mailbox_result.version, &mclw_dut_mailbox_result.capacity,
		MCLW_DUT_MAILBOX_RESULT_MAGIC1, MCLW_DUT_MAILBOX_RESULT_CAPACITY);
}

/*
 * The host reads the record in ascending address order, so the writer goes
 * the other way: sequence_end first, sequence_begin last. Any read that
 * overlaps a publish then sees begin != end. The old order (begin first)
 * let a whole publish hide inside one slow SWD read.
 */
static void publish_result(void)
{
	uint32_t next = mclw_dut_mailbox_result.sequence_begin + 1U;

	mclw_dut_mailbox_result.sequence_end = next;
	barrier_dmem_fence_full();
	memcpy(mclw_dut_mailbox_result.payload, result_line, result_used);
	memset(mclw_dut_mailbox_result.payload + result_used, 0,
		MCLW_DUT_MAILBOX_RESULT_CAPACITY - result_used);
	mclw_dut_mailbox_result.length = (uint32_t)result_used;
	barrier_dmem_fence_full();
	mclw_dut_mailbox_result.sequence_begin = next;
}

void mclw_dut_mailbox_write(const char *text)
{
	if (text == NULL) {
		return;
	}
	for (; *text != '\0'; text++) {
		if (result_used < sizeof(result_line)) {
			result_line[result_used++] = *text;
		}
		if (*text == '\n') {
			publish_result();
			result_used = 0U;
		}
	}
}

bool mclw_dut_mailbox_poll(char *command, size_t capacity)
{
	uint32_t begin;
	uint32_t end;
	uint32_t length;

	if (command == NULL || capacity == 0U ||
		mclw_dut_mailbox_command.magic0 != MCLW_DUT_MAILBOX_MAGIC0 ||
		mclw_dut_mailbox_command.magic1 != MCLW_DUT_MAILBOX_COMMAND_MAGIC1 ||
		mclw_dut_mailbox_command.version != MCLW_DUT_MAILBOX_VERSION ||
		mclw_dut_mailbox_command.capacity != MCLW_DUT_MAILBOX_COMMAND_CAPACITY) {
		return false;
	}
	begin = mclw_dut_mailbox_command.sequence_begin;
	barrier_dmem_fence_full();
	length = mclw_dut_mailbox_command.length;
	if (length == 0U || length > MCLW_DUT_MAILBOX_COMMAND_CAPACITY || length >= capacity) {
		return false;
	}
	memcpy(command, mclw_dut_mailbox_command.payload, length);
	barrier_dmem_fence_full();
	end = mclw_dut_mailbox_command.sequence_end;
	if (begin == 0U || begin != end || begin == command_seen) {
		return false;
	}
	command[length] = '\0';
	command_seen = end;
	return true;
}
```

## src/mailbox.h
```c
// SPDX-License-Identifier: Apache-2.0 OR MIT

#ifndef MCLW_DUT_MAILBOX_H
#define MCLW_DUT_MAILBOX_H

#include <stdbool.h>
#include <stddef.h>
#include <stdint.h>

#define MCLW_DUT_MAILBOX_MAGIC0 0x574c434dU
#define MCLW_DUT_MAILBOX_COMMAND_MAGIC1 0x31444d43U
#define MCLW_DUT_MAILBOX_RESULT_MAGIC1 0x31534552U
#define MCLW_DUT_MAILBOX_VERSION 1U

#define MCLW_DUT_MAILBOX_COMMAND_CAPACITY 100U
#define MCLW_DUT_MAILBOX_RESULT_CAPACITY 484U

struct mclw_dut_mailbox_command {
	uint32_t magic0;
	uint32_t magic1;
	uint32_t version;
	uint32_t capacity;
	volatile uint32_t sequence_begin;
	volatile uint32_t length;
	char payload[MCLW_DUT_MAILBOX_COMMAND_CAPACITY];
	volatile uint32_t sequence_end;
};

struct mclw_dut_mailbox_result {
	uint32_t magic0;
	uint32_t magic1;
	uint32_t version;
	uint32_t capacity;
	volatile uint32_t sequence_begin;
	volatile uint32_t length;
	char payload[MCLW_DUT_MAILBOX_RESULT_CAPACITY];
	volatile uint32_t sequence_end;
};

_Static_assert(sizeof(struct mclw_dut_mailbox_command) == 128U,
	"mailbox command record must stay 128 bytes");
_Static_assert(sizeof(struct mclw_dut_mailbox_result) == 512U,
	"mailbox result record must stay 512 bytes");

extern struct mclw_dut_mailbox_command mclw_dut_mailbox_command;
extern struct mclw_dut_mailbox_result mclw_dut_mailbox_result;

void mclw_dut_mailbox_init(void);
void mclw_dut_mailbox_write(const char *text);
bool mclw_dut_mailbox_poll(char *command, size_t capacity);

#endif
```

## src/uart_echo.c
```c
// SPDX-License-Identifier: Apache-2.0 OR MIT

/*
 * An image whose devicetree has an `echo-uart` alias sends every byte that
 * UART receives straight back for as long as it runs: whatever reaches the
 * DUT on that UART returns unchanged, at line rate in both directions. No
 * command starts or stops it.
 *
 * The interrupt only receives. Sending runs in a thread below main's
 * priority with uart_poll_out(): the PL011 driver's uart_irq_tx_enable()
 * calls the interrupt callback in a loop from wherever it is called, so
 * starting transmission from the callback would re-enter it.
 */

#include <zephyr/device.h>
#include <zephyr/devicetree.h>
#include <zephyr/kernel.h>

#if DT_NODE_EXISTS(DT_ALIAS(echo_uart)) && defined(CONFIG_UART_INTERRUPT_DRIVEN)
#include <zephyr/drivers/uart.h>
#include <zephyr/sys/ring_buffer.h>

#include <stdint.h>

#define ECHO_RING_SIZE 4096U
#define ECHO_CHUNK 32U
#define ECHO_STACK_SIZE 1024
#define ECHO_PRIORITY 7

static const struct device *const echo_dev = DEVICE_DT_GET(DT_ALIAS(echo_uart));
RING_BUF_DECLARE(echo_ring, ECHO_RING_SIZE);
static K_SEM_DEFINE(echo_ready, 0, 1);

/* One producer (this interrupt) and one consumer (the thread) need no lock. */
static void echo_isr(const struct device *dev, void *user_data)
{
	(void)user_data;
	while (uart_irq_update(dev) > 0 && uart_irq_rx_ready(dev) > 0) {
		uint8_t chunk[ECHO_CHUNK];
		int n = uart_fifo_read(dev, chunk, sizeof(chunk));

		if (n <= 0) {
			break;
		}
		(void)ring_buf_put(&echo_ring, chunk, (uint32_t)n);
		k_sem_give(&echo_ready);
	}
}

static void echo_thread(void *a, void *b, void *c)
{
	(void)a;
	(void)b;
	(void)c;
	if (!device_is_ready(echo_dev) ||
		uart_irq_callback_user_data_set(echo_dev, echo_isr, NULL) != 0) {
		return;
	}
	uart_irq_rx_enable(echo_dev);
	for (;;) {
		uint8_t chunk[ECHO_CHUNK];
		uint32_t n;

		(void)k_sem_take(&echo_ready, K_FOREVER);
		while ((n = ring_buf_get(&echo_ring, chunk, sizeof(chunk))) > 0U) {
			for (uint32_t i = 0; i < n; i++) {
				uart_poll_out(echo_dev, chunk[i]);
			}
		}
	}
}

K_THREAD_DEFINE(echo_tid, ECHO_STACK_SIZE, echo_thread, NULL, NULL, NULL, ECHO_PRIORITY, 0, 0);
#endif
```

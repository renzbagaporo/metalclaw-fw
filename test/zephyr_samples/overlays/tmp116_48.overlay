/* SPDX-License-Identifier: Apache-2.0 OR MIT */
/*
 * A TMP116 at 0x48 (ADD0 to GND) on I2C0 (i2c0.overlay) with its EEPROM,
 * as the tmp11x sample's own board overlay has it.
 */

&i2c0 {
	ti_tmp11x: ti_tmp11x@48 {
		compatible = "ti,tmp11x";
		reg = <0x48>;
		#address-cells = <1>;
		#size-cells = <0>;
		status = "okay";

		eeprom: ti_tmp11x_eeprom@0 {
			compatible = "ti,tmp11x-eeprom";
			reg = <0x0>;
			read-only;
		};
	};
};

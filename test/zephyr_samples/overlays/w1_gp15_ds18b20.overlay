/* SPDX-License-Identifier: Apache-2.0 OR MIT */
/*
 * A bit-banged 1-Wire bus on GP15 (zephyr,w1-gpio), open drain, with a
 * DS18B20 on it: the sensor/ds18b20 sample finds the sensor by its
 * compatible, drivers/w1/scanner the bus by its w1 label. The DUT pad's
 * pull-up carries the line where the bench has none (fixture 1); the
 * carrier adds its 5.1 k.
 */
#include <zephyr/dt-bindings/gpio/gpio.h>

/ {
	w1: w1 {
		compatible = "zephyr,w1-gpio";
		gpios = <&gpio0 15 (GPIO_ACTIVE_HIGH | GPIO_OPEN_DRAIN | GPIO_PULL_UP)>;
		status = "okay";

		ds18b20 {
			compatible = "maxim,ds18b20";
			family-code = <0x28>;
			resolution = <12>;
			status = "okay";
		};
	};
};

/* SPDX-License-Identifier: Apache-2.0 OR MIT */
/*
 * A 128x64 SSD1306 at 0x3C on I2C0 (i2c0.overlay) as the zephyr,display,
 * with the panel settings of Zephyr's own ssd1306_128x64 shield
 * (boards/shields/ssd1306/ssd1306_128x64.overlay).
 */
/ {
	chosen {
		zephyr,display = &ssd1306_3c;
	};
};

&i2c0 {
	ssd1306_3c: ssd1306@3c {
		compatible = "solomon,ssd1306";
		reg = <0x3c>;
		width = <128>;
		height = <64>;
		segment-offset = <0>;
		page-offset = <0>;
		display-offset = <0>;
		multiplex-ratio = <63>;
		segment-remap;
		com-invdir;
		prechargep = <0x22>;
	};
};

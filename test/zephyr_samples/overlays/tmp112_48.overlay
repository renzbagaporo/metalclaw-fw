/* SPDX-License-Identifier: Apache-2.0 OR MIT */
/* A TMP112 at 0x48 (ADD0 to GND) on I2C0 (i2c0.overlay). */

&i2c0 {
	tmp112@48 {
		compatible = "ti,tmp112";
		reg = <0x48>;
		status = "okay";
	};
};

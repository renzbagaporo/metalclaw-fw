/* SPDX-License-Identifier: Apache-2.0 OR MIT */
/*
 * samples/basic/custom_dts_binding drives a "power-switch" node of its own
 * binding (dts/bindings); its nucleo_l073rz overlay puts it on that board's
 * LED, and this one on the Picos' LED, GP25.
 */
#include <zephyr/dt-bindings/gpio/gpio.h>

/ {
	load_switch: load_switch {
		compatible = "power-switch";
		gpios = <&gpio0 25 GPIO_ACTIVE_HIGH>;
	};
};

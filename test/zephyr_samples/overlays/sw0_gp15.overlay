/* SPDX-License-Identifier: Apache-2.0 OR MIT */
/*
 * A gpio-keys button as sw0 on GP15, active low with the pad's pull-up, as
 * a button to ground: the Picos have none on a GPIO. Its key is
 * INPUT_KEY_0 (11).
 */
#include <zephyr/dt-bindings/gpio/gpio.h>
#include <zephyr/dt-bindings/input/input-event-codes.h>

/ {
	buttons {
		compatible = "gpio-keys";

		sw0: button_0 {
			gpios = <&gpio0 15 (GPIO_PULL_UP | GPIO_ACTIVE_LOW)>;
			label = "Button 0";
			zephyr,code = <INPUT_KEY_0>;
		};
	};

	aliases {
		sw0 = &sw0;
	};
};

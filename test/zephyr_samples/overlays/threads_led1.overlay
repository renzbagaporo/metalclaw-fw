/* SPDX-License-Identifier: Apache-2.0 OR MIT */
/*
 * samples/basic/threads blinks led0 and led1; the Picos have led0 only
 * (boards/raspberrypi/common/rpi_pico-led.dtsi). led1 on GP14, a pin the
 * harness reaches on both benches.
 */
#include <zephyr/dt-bindings/gpio/gpio.h>

/ {
	leds {
		led1: led_1 {
			gpios = <&gpio0 14 GPIO_ACTIVE_HIGH>;
			label = "LED 1";
		};
	};

	aliases {
		led1 = &led1;
	};
};
